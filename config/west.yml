## config/west.yml
```yaml
manifest:
  remotes:
    - name: zmkfirmware
      url-base: https://github.com/nguyenbaan
    # Additional modules containing boardsshields/custom cod can be listed here as well
    # See https://docs.zephyrproject.org/3.2.0develop/west/manifest.html#projects
  projects:
    - name: zmk
      remote: zmkfirmware
      revision: main
      import: app/west.yml
  self:
    path: config
```
